## esp32/bad_apple/main/Kconfig.projbuild
```kconfig
menu "Example Configuration"


config WIFI_SSID
    string "WiFi SSID"
	default "myssid"
	help
		SSID (network name) for the example to connect to.

config WIFI_PASSWORD
    string "WiFi Password"
	default "mypassword"
	help
		WiFi password (WPA or WPA2) for the example to use.

		Can be left blank if the network has no security set.

config TCP_PERF_PKT_SIZE
    int "Size of TCP packet"
    default 1460
    help
	the data send&recv packet size. 
	
endmenu
```
